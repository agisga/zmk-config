#include "minidox.dtsi"

&default_transform {
  col-offset = <5>;
};

&kscan0 {
  col-gpios
    = <&pro_micro 4 GPIO_ACTIVE_HIGH>
    , <&pro_micro 2 GPIO_ACTIVE_HIGH>
    , <&pro_micro 0 GPIO_ACTIVE_HIGH>
    , <&pro_micro 1 GPIO_ACTIVE_HIGH>
    , <&pro_micro 21 GPIO_ACTIVE_HIGH>
    ;
};
