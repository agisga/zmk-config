## boards/shields/minidox/Kconfig.shield
```kconfig
config SHIELD_MINIDOX_LEFT
    def_bool $(shields_list_contains,minidox_left)

config SHIELD_MINIDOX_RIGHT
    def_bool $(shields_list_contains,minidox_right)
```

## boards/shields/nowt36lp/Kconfig.defconfig
```kconfig
if SHIELD_NOWT36LP

# Name must be less than 16 characters long!
config ZMK_KEYBOARD_NAME
    default "nowt36lp"

endif
```

## config/boards/shields/minidox/Kconfig.defconfig
```kconfig
if SHIELD_MINIDOX_LEFT

config ZMK_KEYBOARD_NAME
    default "Minidox"

config ZMK_SPLIT_ROLE_CENTRAL
    default y

endif

if SHIELD_MINIDOX_LEFT || SHIELD_MINIDOX_RIGHT

config ZMK_SPLIT
    default y

endif
```
